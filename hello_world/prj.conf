## CMakeLists.txt
```
# SPDX-License-Identifier: Apache-2.0

cmake_minimum_required(VERSION 3.20.0)

set(DTS_ROOT ${CMAKE_CURRENT_SOURCE_DIR}/dts)
set(MCXA_LIB_DIR "${CMAKE_CURRENT_SOURCE_DIR}/../../../MCXA_Lib/Lib" CACHE PATH "Path to the reusable MCXA library sources")
get_filename_component(MCXA_LIB_DIR "${MCXA_LIB_DIR}" ABSOLUTE)

if(NOT EXISTS "${MCXA_LIB_DIR}/cmake/MCXAComponents.cmake")
    message(FATAL_ERROR
        "MCXA_LIB_DIR is invalid: ${MCXA_LIB_DIR}"
    )
endif()

option(APP_STANDALONE "Boot directly from internal flash without external storage" ON)
option(APP_BOOT_TRACE "Print Zephyr device initialization progress" OFF)
if(APP_BOOT_TRACE)
    list(APPEND EXTRA_CONF_FILE "${CMAKE_CURRENT_SOURCE_DIR}/boot_trace.conf")
endif()

if(APP_STANDALONE)
    list(APPEND EXTRA_CONF_FILE "${CMAKE_CURRENT_SOURCE_DIR}/standalone.conf")
endif()

set(DTC_OVERLAY_FILE
    "${CMAKE_CURRENT_SOURCE_DIR}/src/CustomOverlay/GPIOCtrl.overlay"
    "${CMAKE_CURRENT_SOURCE_DIR}/src/CustomOverlay/PWMCtrl.overlay"
    "${CMAKE_CURRENT_SOURCE_DIR}/src/CustomOverlay/DACCtrl.overlay"
    "${CMAKE_CURRENT_SOURCE_DIR}/src/CustomOverlay/ADCCtrl.overlay"
    "${CMAKE_CURRENT_SOURCE_DIR}/src/CustomOverlay/SPIPinCtrl.overlay"
    "${CMAKE_CURRENT_SOURCE_DIR}/src/CustomOverlay/LVGLDisplayctrl.overlay"
    "${CMAKE_CURRENT_SOURCE_DIR}/src/CustomOverlay/eQDCCtrl.overlay"
    "${CMAKE_CURRENT_SOURCE_DIR}/src/CustomOverlay/SPI1_ExtFlashCtrl.overlay"
    "${CMAKE_CURRENT_SOURCE_DIR}/src/CustomOverlay/FlashPartitions.overlay"
    "${CMAKE_CURRENT_SOURCE_DIR}/src/CustomOverlay/ExtFlash_Ctrl.overlay"
    "${CMAKE_CURRENT_SOURCE_DIR}/src/CustomOverlay/FlexIO_I2S.overlay"
    CACHE STRING "Application devicetree overlays" FORCE)

if(APP_STANDALONE)
    list(REMOVE_ITEM DTC_OVERLAY_FILE
        "${CMAKE_CURRENT_SOURCE_DIR}/src/CustomOverlay/SPI1_ExtFlashCtrl.overlay"
        "${CMAKE_CURRENT_SOURCE_DIR}/src/CustomOverlay/FlashPartitions.overlay"
        "${CMAKE_CURRENT_SOURCE_DIR}/src/CustomOverlay/ExtFlash_Ctrl.overlay")
    list(APPEND DTC_OVERLAY_FILE
        "${CMAKE_CURRENT_SOURCE_DIR}/src/CustomOverlay/Standalone.overlay")
    set(DTC_OVERLAY_FILE "${DTC_OVERLAY_FILE}" CACHE STRING "Application devicetree overlays" FORCE)
endif()

find_package(Zephyr REQUIRED HINTS $ENV{ZEPHYR_BASE})
project(hello_world)

set(SELECTED_AUDIO_GUI_DIR
    "${CMAKE_CURRENT_SOURCE_DIR}/src/LVGL_Controller/Screens/SelectedAudioSource/SelectedAudioSrc_Bluetooth/GUI_Guider_Generated")
set(SELECTED_AUDIO_GUI_SCREEN_SOURCE
    "${SELECTED_AUDIO_GUI_DIR}/generated/screens/gg_Home_revised.c")
set(SELECTED_AUDIO_GUI_EVENT_SOURCE
    "${SELECTED_AUDIO_GUI_DIR}/generated/events/gg_event_Home_revised.c")

set(SELECTED_AUDIO_WIRED_GUI_DIR
    "${CMAKE_CURRENT_SOURCE_DIR}/src/LVGL_Controller/Screens/SelectedAudioSource/SelectedAudioSrc_Wired/GUI_Guider_Generated")
set(SELECTED_AUDIO_WIRED_GUI_SCREEN_SOURCE
    "${SELECTED_AUDIO_WIRED_GUI_DIR}/generated/screens/gg_Home_revised.c")
set(SELECTED_AUDIO_WIRED_GUI_EVENT_SOURCE
    "${SELECTED_AUDIO_WIRED_GUI_DIR}/generated/events/gg_event_Home_revised.c")

set(AUDIO_SRC_SELECTION_GUI_DIR
    "${CMAKE_CURRENT_SOURCE_DIR}/src/LVGL_Controller/Screens/AudioSourceSelect_Menu/GUI_Guider_Generated")
set(AUDIO_SRC_SELECTION_GUI_SCREEN_SOURCE
    "${AUDIO_SRC_SELECTION_GUI_DIR}/generated/screens/gg_Source_Selection_revised.c")
set(AUDIO_SRC_SELECTION_GUI_EVENT_SOURCE
    "${AUDIO_SRC_SELECTION_GUI_DIR}/generated/events/gg_event_Source_Selection_revised.c")

set(AUDIO_SRC_MUTE_GUI_DIR
    "${CMAKE_CURRENT_SOURCE_DIR}/src/LVGL_Controller/Screens/AudioSrcMute/GUI_Guider_Generated")
set(AUDIO_SRC_MUTE_GUI_SCREEN_SOURCE
    "${AUDIO_SRC_MUTE_GUI_DIR}/generated/screens/gg_Home_revised.c")
set(AUDIO_SRC_MUTE_GUI_EVENT_SOURCE
    "${AUDIO_SRC_MUTE_GUI_DIR}/generated/events/gg_event_Home_revised.c")

set(MENU_SELECTION_GUI_DIR
    "${CMAKE_CURRENT_SOURCE_DIR}/src/LVGL_Controller/Screens/MenuSelection/GUI_Guider_Generated")
set(MENU_SELECTION_GUI_SCREEN_SOURCE
    "${MENU_SELECTION_GUI_DIR}/generated/screens/gg_Menu_revised.c")
set(MENU_SELECTION_GUI_EVENT_SOURCE
    "${MENU_SELECTION_GUI_DIR}/generated/events/gg_event_Menu_revised.c")

set(BLUETOOTH_MENU_GUI_DIR
    "${CMAKE_CURRENT_SOURCE_DIR}/src/LVGL_Controller/Screens/BluetoothMenu/GUI_Guider_Generated")
set(BLUETOOTH_MENU_GUI_SCREEN_SOURCE
    "${BLUETOOTH_MENU_GUI_DIR}/generated/screens/gg_Bluetooth_Menu.c")
set(BLUETOOTH_MENU_GUI_EVENT_SOURCE
    "${BLUETOOTH_MENU_GUI_DIR}/generated/events/gg_event_Bluetooth_Menu.c")

set(BLUETOOTH_CONNECTION_GUI_DIR
    "${CMAKE_CURRENT_SOURCE_DIR}/src/LVGL_Controller/Screens/BluetoothConnection/GUI_Guider_Generated")
set(BLUETOOTH_CONNECTION_GUI_SCREEN_SOURCE
    "${BLUETOOTH_CONNECTION_GUI_DIR}/generated/screens/gg_Connected_revised.c")
set(BLUETOOTH_CONNECTION_GUI_EVENT_SOURCE
    "${BLUETOOTH_CONNECTION_GUI_DIR}/generated/events/gg_event_Connected_revised.c")

zephyr_compile_options("-ffile-prefix-map=${MCXA_LIB_DIR}=MCXA_LIB")

# Keep the generated external-IRQ vectors immediately after the Cortex-M
# exception vectors. Zephyr 4.4 registers both snippets with the same legacy
# linker sort key, which can omit irq-vector-table-section.ld from ROM_START.
zephyr_linker_sources(
    ROM_START
    SORT_KEY 0x0vectors_irq
    ${ZEPHYR_BASE}/include/zephyr/linker/irq-vector-table-section.ld)

include("${MCXA_LIB_DIR}/cmake/MCXAComponents.cmake")

#This is required to add specific library classes. Refer to 'APIList.h' in library for all the keywords
#required to enable specific library classes. For example, to enable CAN, SPI, QDC and AK4148, the following is required.
mcxa_target_components(
    TARGET app
    CONFIG_DIR "${CMAKE_CURRENT_SOURCE_DIR}/config/mcxa"
    COMPONENTS
        CAN
        SPI
        QDC
        AK4148
        FlexIO_I2S
)

target_sources(app PRIVATE  
                src/main.c 

                src/CAN_Controller/CAN_Controller.c 
                src/Bootloader_Controller/Bootloader_Ctrl.c 
                
                src/WallController/WallController_StateMachine/WallController_StateMachine.c
                src/WallController/WallController_Comm_Manager/WallController_Comm_Manager.c
                src/LVGL_Controller/UI_InputController/UI_InputController.c
                src/LVGL_Controller/UI_ScreenManager/UI_ScreenManager.c                
                src/LVGL_Controller/LVGL_Display_Controller.c 
                src/LVGL_Controller/FileSystem_Adapter/LVGL_ZephyrFS_Adapter.c  
                src/LVGL_Controller/LVGL_TextAnimator/LVGL_TextAnimate.c 

                #Welcome Screen
                src/LVGL_Controller/Screens/Screen_Welcome/WelcomeScreen.c
                src/LVGL_Controller/Screens/Screen_Welcome/GUI_Guider_Generated/generated/screens/gg_Sleep_Screen.c
                src/LVGL_Controller/Screens/Screen_Welcome/GUI_Guider_Generated/generated/events/gg_event_Sleep_Screen.c
                #Selected Audio Source
                src/LVGL_Controller/Screens/SelectedAudioSource/SelectedAudioSrcCtrl.c
                src/LVGL_Controller/Screens/SelectedAudioSource/SelectedAudioSrc_Bluetooth/SelectedAudioSrcBluetooth_View.c
                src/LVGL_Controller/Screens/SelectedAudioSource/SelectedAudioSrc_Wired/SelectedAudioSrcWired_View.c

                #AudioSrc Selection Screen
                src/LVGL_Controller/Screens/AudioSourceSelect_Menu/AudioSrcSelection.c 
                ${AUDIO_SRC_SELECTION_GUI_SCREEN_SOURCE}
                ${AUDIO_SRC_SELECTION_GUI_EVENT_SOURCE}
                
                #Muted Audio Source Screen
                src/LVGL_Controller/Screens/AudioSrcMute/AudioSrcMute.c
                ${AUDIO_SRC_MUTE_GUI_SCREEN_SOURCE}
                ${AUDIO_SRC_MUTE_GUI_EVENT_SOURCE}

                #Main Menu Selection Screen
                ${MENU_SELECTION_GUI_SCREEN_SOURCE}
                ${MENU_SELECTION_GUI_EVENT_SOURCE}

                #Bluetooth Menu Screen
                src/LVGL_Controller/Screens/BluetoothMenu/BluetoothMenu.c
                ${BLUETOOTH_MENU_GUI_SCREEN_SOURCE}
                ${BLUETOOTH_MENU_GUI_EVENT_SOURCE}
                ${BLUETOOTH_MENU_GUI_DIR}/generated/assets/fonts/lv_font_Roboto_Bold_12.c
                ${BLUETOOTH_MENU_GUI_DIR}/generated/assets/fonts/lv_font_Roboto_Bold_16.c

                #Bluetooth Connection Screen
                src/LVGL_Controller/Screens/BluetoothConnection/BluetoothControl.c
                ${BLUETOOTH_CONNECTION_GUI_SCREEN_SOURCE}
                ${BLUETOOTH_CONNECTION_GUI_EVENT_SOURCE}
                ${BLUETOOTH_CONNECTION_GUI_DIR}/generated/assets/fonts/lv_font_Roboto_Bold_12.c
                ${BLUETOOTH_CONNECTION_GUI_DIR}/generated/assets/fonts/lv_font_Roboto_Bold_16.c

                ${SELECTED_AUDIO_GUI_SCREEN_SOURCE}
                ${SELECTED_AUDIO_GUI_EVENT_SOURCE}
                ${SELECTED_AUDIO_GUI_DIR}/generated/assets/fonts/lv_font_montserratMedium_45.c
                ${SELECTED_AUDIO_GUI_DIR}/generated/assets/fonts/lv_font_Roboto_Bold_9.c
                ${SELECTED_AUDIO_GUI_DIR}/generated/assets/fonts/lv_font_Roboto_Bold_10.c
                ${SELECTED_AUDIO_GUI_DIR}/generated/assets/fonts/lv_font_Roboto_Bold_12.c
                ${SELECTED_AUDIO_GUI_DIR}/generated/assets/fonts/lv_font_Roboto_Bold_13.c
                ${SELECTED_AUDIO_WIRED_GUI_SCREEN_SOURCE}
                ${SELECTED_AUDIO_WIRED_GUI_EVENT_SOURCE}
                ${SELECTED_AUDIO_WIRED_GUI_DIR}/generated/assets/fonts/lv_font_Roboto_Bold_16.c
                ${SELECTED_AUDIO_WIRED_GUI_DIR}/generated/assets/fonts/lv_font_Roboto_Bold_52.c

                #MainMenuSelection
                src/LVGL_Controller/Screens/MenuSelection/MenuSelection.c

                src/PC_UART_API/PC_UART_API.c
                src/PC_UART_API/PC_UART_FWBridgeService.c
                src/PC_UART_API/PC_UART_BulkFileService.c
                src/PC_UART_API/PC_UART_API_ValidateTest.c 

                src/ExtFlash_Controller/ExtFlash_Controller.c 
                src/ExtFlash_Controller/SPIController/SPIController.c 
                src/ExtFlash_Controller/ExtFlashInitialSetup/ExtFlash_InitialSetupCtrl.c 
                src/ExtFlash_Controller/ExtFlashReadWrite/ExtFlash_ReadWriteControl.c
                src/ExtFlash_Controller/Flash_Memory_ValidateTest/Flash_Memory_ValidateTest.c 
                src/ExtFlash_Controller/ZephyrFlashMiddleWare/ZephyrFlashMiddleWare.c
                src/ExtFlash_Controller/LittleFsController/LittleFs_Controller.c
                src/ExtFlash_Controller/AudioSrcConfiguration/AudioSrcConfiguration.c 
                
                src/Temp/Temp.c)

target_include_directories(app PRIVATE
    ${CMAKE_CURRENT_SOURCE_DIR}/src/LVGL_Controller/Screens/Screen_Welcome/GUI_Guider_Generated/generated
    ${CMAKE_CURRENT_SOURCE_DIR}/src/LVGL_Controller/Screens/Screen_Welcome/GUI_Guider_Generated/custom
)

# The GUI Guider exports contain headers with the same names. Keep each
# generated source's include search local to its own export.
set_property(SOURCE
    ${SELECTED_AUDIO_GUI_SCREEN_SOURCE}
    ${SELECTED_AUDIO_GUI_EVENT_SOURCE}
    APPEND PROPERTY COMPILE_OPTIONS
        "-iquote${SELECTED_AUDIO_GUI_DIR}/generated"
        "-iquote${SELECTED_AUDIO_GUI_DIR}/custom"
)

set_property(SOURCE
    ${SELECTED_AUDIO_WIRED_GUI_SCREEN_SOURCE}
    ${SELECTED_AUDIO_WIRED_GUI_EVENT_SOURCE}
    APPEND PROPERTY COMPILE_OPTIONS
        "-iquote${SELECTED_AUDIO_WIRED_GUI_DIR}/generated"
        "-iquote${SELECTED_AUDIO_WIRED_GUI_DIR}/custom"
)

set_property(SOURCE
    ${AUDIO_SRC_SELECTION_GUI_SCREEN_SOURCE}
    ${AUDIO_SRC_SELECTION_GUI_EVENT_SOURCE}
    APPEND PROPERTY COMPILE_OPTIONS
        "-iquote${AUDIO_SRC_SELECTION_GUI_DIR}/generated"
        "-iquote${AUDIO_SRC_SELECTION_GUI_DIR}/custom"
)

set_property(SOURCE
    ${AUDIO_SRC_MUTE_GUI_SCREEN_SOURCE}
    ${AUDIO_SRC_MUTE_GUI_EVENT_SOURCE}
    APPEND PROPERTY COMPILE_OPTIONS
        "-iquote${AUDIO_SRC_MUTE_GUI_DIR}/generated"
        "-iquote${AUDIO_SRC_MUTE_GUI_DIR}/custom"
)

set_property(SOURCE
    ${MENU_SELECTION_GUI_SCREEN_SOURCE}
    ${MENU_SELECTION_GUI_EVENT_SOURCE}
    APPEND PROPERTY COMPILE_OPTIONS
        "-iquote${MENU_SELECTION_GUI_DIR}/generated"
        "-iquote${MENU_SELECTION_GUI_DIR}/custom"
)

set_property(SOURCE
    ${BLUETOOTH_MENU_GUI_SCREEN_SOURCE}
    ${BLUETOOTH_MENU_GUI_EVENT_SOURCE}
    APPEND PROPERTY COMPILE_OPTIONS
        "-iquote${BLUETOOTH_MENU_GUI_DIR}/generated"
        "-iquote${BLUETOOTH_MENU_GUI_DIR}/custom"
)

set_property(SOURCE
    ${BLUETOOTH_CONNECTION_GUI_SCREEN_SOURCE}
    ${BLUETOOTH_CONNECTION_GUI_EVENT_SOURCE}
    APPEND PROPERTY COMPILE_OPTIONS
        "-iquote${BLUETOOTH_CONNECTION_GUI_DIR}/generated"
        "-iquote${BLUETOOTH_CONNECTION_GUI_DIR}/custom"
)


# Standalone boards have no external storage or MCUboot services.
if(APP_STANDALONE)
    target_compile_definitions(app PRIVATE APP_STANDALONE=1)
    get_target_property(app_sources app SOURCES)
    list(FILTER app_sources EXCLUDE REGEX "src/Bootloader_Controller/Bootloader_Ctrl[.]c$")
    list(FILTER app_sources EXCLUDE REGEX "src/ExtFlash_Controller/(ExtFlash_Controller[.]c|SPIController/.*|ExtFlashInitialSetup/.*|ExtFlashReadWrite/.*|Flash_Memory_ValidateTest/.*|ZephyrFlashMiddleWare/.*|LittleFsController/LittleFs_Controller[.]c)$")
    set_property(TARGET app PROPERTY SOURCES "${app_sources}")
    target_sources(app PRIVATE src/Standalone/UnavailableServices.c)
endif()

if(APP_BOOT_TRACE)
    target_sources(app PRIVATE src/Standalone/BootTrace.c)
endif()
```

## sample.yaml
```
sample:
  description: Hello World sample, the simplest Zephyr
    application
  name: hello world
common:
  min_ram: 2
  min_flash: 16
  tags: introduction
  integration_platforms:
    - native_sim
  harness: console
  harness_config:
    type: one_line
    regex:
      - "Hello World! (.*)"
tests:
  sample.basic.helloworld:
    tags: introduction
```

## prj.conf
```kconfig
CONFIG_BUILD_OUTPUT_HEX=y
CONFIG_REBOOT=y
CONFIG_CRC=y

CONFIG_MAIN_STACK_SIZE=8192

# Detect stack corruption. The enlarged system workqueue stack is required by
# the bulk-transfer error/cleanup path.
CONFIG_STACK_SENTINEL=y
CONFIG_SYSTEM_WORKQUEUE_STACK_SIZE=4096

CONFIG_THREAD_RUNTIME_STATS=y
CONFIG_THREAD_RUNTIME_STATS_USE_TIMING_FUNCTIONS=y
CONFIG_SCHED_THREAD_USAGE=y
CONFIG_THREAD_MONITOR=y
CONFIG_TIMING_FUNCTIONS=y

CONFIG_INPUT=y
CONFIG_INPUT_GPIO_KEYS=y

CONFIG_PWM=y
CONFIG_SERIAL=y
CONFIG_CAN=y
CONFIG_CAN_FD_MODE=y
CONFIG_CAN_DEFAULT_BITRATE=500000
CONFIG_CAN_DEFAULT_BITRATE_DATA=2000000
CONFIG_CAN_MANUAL_RECOVERY_MODE=y
CONFIG_DAC=y

CONFIG_DMA=y
CONFIG_NXP_INPUTMUX=y
CONFIG_DMA_TCD_QUEUE_SIZE=4

CONFIG_BOOTLOADER_MCUBOOT=y
CONFIG_MCUBOOT_SIGNATURE_KEY_FILE="keys/wallcontroller_signingkey.pem"
CONFIG_FLASH=y
CONFIG_FLASH_MAP=y
CONFIG_STREAM_FLASH=y
CONFIG_IMG_MANAGER=y
CONFIG_MCUBOOT_IMG_MANAGER=y
CONFIG_REBOOT=y

CONFIG_SPI=y
CONFIG_SPI_ASYNC=y

CONFIG_DISPLAY=y
CONFIG_ST7735R=y

CONFIG_LVGL=y
CONFIG_LV_COLOR_DEPTH_16=y
CONFIG_LV_COLOR_16_SWAP=y
CONFIG_LV_COLOR_16_SWAP=y
CONFIG_LV_Z_FLUSH_THREAD=y
CONFIG_LV_Z_LVGL_MUTEX=y
CONFIG_LV_Z_RUN_LVGL_ON_WORKQUEUE=y
CONFIG_LV_Z_LVGL_WORKQUEUE_STACK_SIZE=6144

CONFIG_LV_FONT_MONTSERRAT_10=y
CONFIG_LV_FONT_MONTSERRAT_12=y
CONFIG_LV_FONT_MONTSERRAT_14=y
CONFIG_LV_FONT_MONTSERRAT_16=y
CONFIG_LV_FONT_MONTSERRAT_18=y
CONFIG_LV_FONT_MONTSERRAT_20=y

CONFIG_LV_Z_MEM_POOL_SIZE=16384
CONFIG_LV_Z_VDB_SIZE=10
# CONFIG_LV_Z_DOUBLE_VDB is not set

CONFIG_LV_USE_LABEL=y
CONFIG_LV_USE_BUTTON=y
CONFIG_LV_USE_IMAGE=y
CONFIG_LV_USE_BAR=y
CONFIG_LV_USE_LINE=y
CONFIG_LV_USE_LIST=y
CONFIG_LV_USE_SLIDER=y

# Keep the LVGL build limited to widgets used by this application.
CONFIG_LV_USE_ANIMIMG=n
CONFIG_LV_USE_ARC=n
CONFIG_LV_USE_ARCLABEL=n
CONFIG_LV_USE_BUTTONMATRIX=n
CONFIG_LV_USE_CALENDAR=n
CONFIG_LV_USE_CANVAS=n
CONFIG_LV_USE_CHART=n
CONFIG_LV_USE_CHECKBOX=n
CONFIG_LV_USE_DROPDOWN=n
CONFIG_LV_USE_IMAGEBUTTON=n
CONFIG_LV_USE_KEYBOARD=n
CONFIG_LV_USE_LED=n
CONFIG_LV_USE_MENU=n
CONFIG_LV_USE_MSGBOX=n
CONFIG_LV_USE_ROLLER=n
CONFIG_LV_USE_SCALE=n
CONFIG_LV_USE_SPAN=n
CONFIG_LV_USE_SPINBOX=n
CONFIG_LV_USE_SPINNER=n
CONFIG_LV_USE_SWITCH=n
CONFIG_LV_USE_TABLE=n
CONFIG_LV_USE_TABVIEW=n
CONFIG_LV_USE_TEXTAREA=n
CONFIG_LV_USE_TILEVIEW=n
CONFIG_LV_USE_WIN=n
CONFIG_LV_USE_GRID=n
CONFIG_LV_USE_OBSERVER=n
CONFIG_LV_USE_THEME_SIMPLE=n

#LPSPI1 and DMA
CONFIG_SPI_NXP_LPSPI=y
CONFIG_DMA=y
CONFIG_SPI_NXP_LPSPI_DMA=y

# External SPI-NOR
CONFIG_FLASH=y
CONFIG_FLASH_PAGE_LAYOUT=y
CONFIG_FLASH_MAP=y

# LittleFS
CONFIG_FILE_SYSTEM=y
CONFIG_FILE_SYSTEM_LITTLEFS=y
CONFIG_FS_LITTLEFS_FMP_DEV=y
```

## mcuboot.conf
```kconfig
# Match the public half of the RSA-2048 key used to sign the application image.
CONFIG_BOOT_SIGNATURE_TYPE_RSA=y
CONFIG_BOOT_SIGNATURE_TYPE_RSA_LEN=2048
CONFIG_BOOT_SIGNATURE_KEY_FILE="${APPLICATION_CONFIG_DIR}/keys/wallcontroller_publickey.pem"
CONFIG_BUILD_OUTPUT_HEX=y

# The secondary image slot is on the external Macronix flash.  Present 8 KiB
# logical sectors to MCUboot so swap-using-offset matches the MCXA156 internal
# flash erase-sector layout.  The SPI-NOR driver still performs the required
# physical 4 KiB erase operations underneath this logical layout.
CONFIG_SPI=y
CONFIG_SPI_NXP_LPSPI=y
CONFIG_SPI_NXP_LPSPI_DMA=n
CONFIG_SPI_NXP_LPSPI_CPU=y
CONFIG_SPI_NOR=y
CONFIG_SPI_NOR_SFDP_MINIMAL=y
CONFIG_SPI_NOR_FLASH_LAYOUT_PAGE_SIZE=8192
CONFIG_WALLCONTROLLER_MCUBOOT_EXTFLASH_PROBE=y
```

## standalone.conf
```kconfig
# Direct application boot; no MCUboot header, signing, or reserved slots.
CONFIG_BOOTLOADER_MCUBOOT=n
CONFIG_USE_DT_CODE_PARTITION=n
CONFIG_FLASH_LOAD_OFFSET=0
CONFIG_FLASH_LOAD_SIZE=0
CONFIG_IMG_MANAGER=n
CONFIG_MCUBOOT_IMG_MANAGER=n
CONFIG_STREAM_FLASH=n
CONFIG_FLASH_MAP=n
CONFIG_FLASH=n
CONFIG_FLASH_PAGE_LAYOUT=n
CONFIG_FILE_SYSTEM_LITTLEFS=n
CONFIG_FS_LITTLEFS_FMP_DEV=n
CONFIG_BUILD_OUTPUT_HEX=y
```

## dts/bindings/misc/merryelectronics,flexio-i2s-clocks.yaml
```yaml
description: |
  Application-owned FlexIO clock generator producing continuous
  BCLK and LRCLK without an audio-data shifter.

compatible: "merryelectronics,flexio-i2s-clocks"

include:
  - base.yaml
  - pinctrl-device.yaml

properties:
  flexio:
    type: phandle
    required: true
    description: FlexIO peripheral used by the clock generator.

  bclk-pin:
    type: int
    required: true
    description: Internal FlexIO signal index for BCLK.

  lrclk-pin:
    type: int
    required: true
    description: Internal FlexIO signal index for LRCLK.

  bclk-timer:
    type: int
    required: true
    description: FlexIO timer index for BCLK.

  lrclk-timer:
    type: int
    required: true
    description: FlexIO timer index for LRCLK.

  bclk-gpios:
    type: phandle-array
    required: true
    description: Active-high BCLK GPIO used to hold the pin low when stopped.

  lrclk-gpios:
    type: phandle-array
    required: true
    description: Active-high LRCLK GPIO used to hold the pin low when stopped.
```

## dts/bindings/misc/merryelectronics,mx25r64-custom.yaml
```yaml
description: Custom MX25R6435F flash using the Sonavox LPSPI driver

compatible: "merryelectronics,mx25r64-custom"

include: base.yaml

properties:
  size-in-bytes:
    type: int
    required: true
    description: Complete flash capacity in bytes

  erase-block-size:
    type: int
    required: true
    description: Minimum erase size in bytes

  write-block-size:
    type: int
    required: true
    description: Minimum supported write size and alignment
```

## dts/bindings/misc/nxp,eqdc-phase-pins.yaml
```yaml
# SPDX-License-Identifier: Apache-2.0

description: NXP eQDC phase-input pin configuration

compatible: "nxp,eqdc-phase-pins"

include: [base.yaml, pinctrl-device.yaml]
```

## src/main.c
```c
/*
 * Copyright (c) 2012-2014 Wind River Systems, Inc.
 *
 * SPDX-License-Identifier: Apache-2.0
 */

#include <stdio.h>
#include <zephyr/sys/printk.h>
#include <zephyr/device.h>
#include <zephyr/dfu/mcuboot.h>
#include <zephyr/drivers/gpio.h>
#include <zephyr/sys/reboot.h>
#include "fsl_clock.h"
#include "fsl_port.h"
#include "CPULoad/NXP_CPU_LoadMon.h"
#include "CAN_Controller/CAN_Controller.h"
#include "WallController/WallController_Comm_Manager/WallController_Comm_Manager.h"
#include "WallController/WallController_StateMachine/Wallcontroller_StateMachine.h"
#include "Bootloader_Controller/Bootloader_Ctrl.h"
#include "PC_UART_API/PC_UART_API.h"
#include "PC_UART_API/PC_UART_API_ProjDef.h"
#include "PC_UART_API/PC_UART_API_ValidateTest.h"
#include "SPI/NXP_SPI_API.h"
#include "LVGL_Controller/LVGL_Display_Controller.h"
#include "ExtFlash_Controller/ExtFlash_Controller.h"
#include "ExtFlash_Controller/Flash_Memory_ValidateTest/Flash_Memory_ValidateTest_ProjDef.h"
#include "ExtFlash_Controller/LittleFsController/LittleFs_Controller.h"
#include "ExtFlash_Controller/AudioSrcConfiguration/AudioSrcConfiguration.h"
#include "FlexIO_I2S_API.h"

bool bInit_System( void );
void vCheck_For_FileSystem( void );
static void vRun_System( void );
static void vHandle_I2SStop(struct k_work *work);

struct k_work_delayable kwork_StopI2S;

int main(void)
{
    printk("\r\n[boot] main reached; console=LPUART0, 115200 8-N-1\r\n");
#if defined(DEBUG_TOGGLE_LPSPI0_SDO_AS_GPIO)
	vDebug_Toggle_LPSPI0_SDO_Pin();
#endif

	//vConfirm_MCUbootImage();
/* 	if(!bInit_System())
	{
		FHALT("SYstem Initialization Failed.");
		printf("System Restarting...\n\r");
		sys_reboot(SYS_REBOOT_COLD);

		CODE_UNREACHABLE;
	} */

    bool initialized = bInit_System();
    printk("[boot] bInit_System returned %d\r\n", initialized);
    int64_t nextHeartbeat = k_uptime_get();

	while (1)
	{
		//vRun_System();
		k_msleep(1);
	}
	
}

static void vRun_System( void )
{
	//vRun_UI();
	//vRun_WallCtrl_StateMachine();
}

bool bInit_System( void )
{
	printf("System Initializing...\n\r");
/* #if !defined(APP_STANDALONE)
	if(!bInit_BootloaderController())
		return false;
#endif
	if(!bInit_WallController_Comm_Manager(NULL))
		return false;
	if(!bInit_CANController())
		return false; */
    printk("[boot] starting PC UART API\r\n");
	vInit_PC_UART_API();
    printk("[boot] PC UART API returned\r\n");
/* 
#if !defined(APP_STANDALONE)
	if(!bInit_ExtFlash_FsController())
		return false;
	vCheck_For_FileSystem();
#else
	printf("Standalone application: external storage and MCUboot updates disabled\n");
	(void)bLoad_AudioConfigurations();
#endif
	
	if(!bInit_LVGLDisplay())
	{
		return false;
	} */
    printk("[boot] starting FlexIO; oscillator wait may block here\r\n");
	if(iInit_FlexIO_I2S() != 0)
	{
		return false;
	}
	if(iStart_FlexIO_I2S() != 0)
	{
		return false;
	}

	k_work_init_delayable(&kwork_StopI2S, vHandle_I2SStop);
	k_work_schedule(&kwork_StopI2S, K_MSEC(4000U));
	return true;
}

static void vHandle_I2SStop(struct k_work *work)
{
	if(bIs_FlexIO_I2S_Running())
	{
		(void)iStop_FlexIO_I2S();		
		k_work_schedule((struct k_work_delayable*)work, K_MSEC(4000U));
	}
	else
	{
		(void)iStart_FlexIO_I2S();
		k_work_schedule((struct k_work_delayable*)work, K_MSEC(4000U));
	}

}

void vCheck_For_FileSystem( void )
{
	printf("Getting File Details...\n\r\n\r");
	const sT_FileInfo_t *pstFiles = pstGetFileInfo();
	if(pstFiles != NULL)
	{
		printf("\n\r");
		for(uint8_t i = 0; i < MAX_FILE_COUNT; i++)
		{
			if(strlen(pstFiles[i].caFilePath) == 0)
				continue;
			printf("File[%d]: %s @Size: %d\n\r", i, pstFiles[i].caFilePath, pstFiles[i].uiFileSize);
		}
		printf("\n\r");
	}
}
```
