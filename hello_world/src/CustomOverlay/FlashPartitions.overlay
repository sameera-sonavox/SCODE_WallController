/*
 * 1 MiB internal flash layout:
 *   MCUboot:  64 KiB
 *   Image 0: 960 KiB
 *
 * All boundaries are aligned to the MCXA156 8 KiB erase block.
 * The secondary image slot is located on the external flash.
 */
&slot0_partition {
    reg = <0x00010000 0x000F0000>;
};

&flash {
    partitions {
        /delete-node/ partition@7a000;
        /delete-node/ partition@e4000;
    };
};
